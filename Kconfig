## Kconfig
```kconfig
# Copyright (c) 2024 The ZMK Contributors
# SPDX-License-Identifier: MIT

rsource "drivers/sensor/adns7530/Kconfig"

config PAW3204
	bool "Bit Trade One ADTB7M PAW3204 Trackball Driver"
	default y
	select INPUT
	help
	  Enable Bit Trade One ADTB7M PAW3204 1u trackball sensor driver.

config KSCAN_KUGEL
	bool "Kugel-1 MCP23S17 Kscan driver"
	default y
	depends on SPI
	select KSCAN
	help
	  Enable custom kscan driver for Kugel-1 using 3x MCP23S17 with HAEN.

config KUGEL_INDICATOR
	bool "Kugel-1 PCB Status LED Indicator"
	default y
	help
	  Enable QMK-equivalent PCB LED status indicator on P0.08 (D100).

config ZMK_NON_LIPO_BATTERY_MANAGEMENT
	bool "Non-LiPo battery monitoring and management"
	default y
	depends on DT_HAS_ZMK_NON_LIPO_BATTERY_ENABLED
	select ADC 
	select ADC_NRFX_SAADC
	help
	  Enable support for non-LiPo batteries (such as alkaline or NiMH).

if ZMK_NON_LIPO_BATTERY_MANAGEMENT

config ZMK_NON_LIPO_MIN_MV
	int "Minimum voltage in millivolts"
	default 1100
	help
	  The minimum voltage level for the battery, corresponding to 0% charge.

config ZMK_NON_LIPO_MAX_MV
	int "Maximum voltage in millivolts"
	default 1300
	help
	  The maximum voltage level for the battery, corresponding to 100% charge.

config ZMK_NON_LIPO_LOW_MV
	int "Low battery threshold in millivolts"
	default 1050
	help
	  The voltage level at which the system will power off to prevent damage.

config ZMK_NON_LIPO_ADV_SLEEP_TIMEOUT
	int "Time in milliseconds after which the device will sleep during advertising"
	default 0
	help
	  If advertising continues for this duration, the device will enter sleep mode.
	  Set to 0 to disable this feature.

endif # ZMK_NON_LIPO_BATTERY_MANAGEMENT
```

## config/boards/shields/kugel/Kconfig.defconfig
```kconfig
# Copyright (c) 2024 The ZMK Contributors
# SPDX-License-Identifier: MIT

if SHIELD_KUGEL

config ZMK_KEYBOARD_NAME
	default "Kugel-1"

config SPI
	default y

config KSCAN_KUGEL
	default y

config ADNS7530
	default y

config ZMK_POINTING
	default y

config INPUT
	default y

endif
```

## config/west.yml
```yaml
manifest:
  remotes:
    - name: zmkfirmware
      url-base: https://github.com/zmkfirmware
    - name: sekigon-gonnoc
      url-base: https://github.com/sekigon-gonnoc
    - name: prospector
      url-base: https://github.com/t-ogura
  projects:
    - name: zmk
      remote: zmkfirmware
      revision: main
      import: app/west.yml
    - name: zmk-feature-non-lipo-battery-management
      remote: sekigon-gonnoc
      revision: main
    - name: prospector-zmk-module
      remote: prospector
      revision: v2.2.2
  self:
    path: config
```

## drivers/sensor/adns7530/Kconfig
```kconfig
# Copyright (c) 2024 The ZMK Contributors
# SPDX-License-Identifier: MIT

menuconfig ADNS7530
	bool "ADNS7530 optical/laser trackball sensor"
	default y
	depends on DT_HAS_ADNS_ADNS7530_ENABLED
	select SPI
	select INPUT
	help
	  Enable driver for ADNS7530 optical mouse/trackball sensor.

if ADNS7530

config ADNS7530_POLL_INTERVAL_MS
	int "Polling interval in milliseconds"
	default 5
	help
	  Time between sensor polling cycles if interrupt is not active.

endif # ADNS7530
```

## dts/bindings/behaviors/zmk,behavior-indicator.yaml
```yaml
# Copyright (c) 2026 The ZMK Contributors
# SPDX-License-Identifier: MIT

description: Status LED indicator behavior

compatible: "zmk,behavior-indicator"

include: one_param.yaml
```

## dts/bindings/behaviors/zmk,behavior-trackball.yaml
```yaml
# Copyright (c) 2024 The ZMK Contributors
# SPDX-License-Identifier: MIT

description: Trackball management behavior

compatible: "zmk,behavior-trackball"

include: one_param.yaml
```

## dts/bindings/kscan/zmk,kscan-kugel.yaml
```yaml
# Copyright (c) 2024 The ZMK Contributors
# SPDX-License-Identifier: MIT

description: Kugel-1 Keyboard Matrix Scanner (MCP23S17 x3 Direct Scan)

compatible: "zmk,kscan-kugel"

include: [kscan.yaml, spi-device.yaml]

properties:
  reset-gpios:
    type: phandle-array
    required: false
    description: Reset GPIO pin for MCP23S17 (Active LOW)

  row-gpios:
    type: phandle-array
    required: false
    description: Common row ground GPIO pin (IO_ROW / Pro Micro 6 / P0.22)

  int-gpios:
    type: phandle-array
    required: false
    description: Shared interrupt GPIO pin from MCP23S17

  wakeup-source:
    type: boolean
    required: false
    description: Enable wakeup from deep sleep via IO_INT
```

## dts/bindings/sensor/adns,adns7530.yaml
```yaml
# Copyright (c) 2024 The ZMK Contributors
# SPDX-License-Identifier: MIT

description: ADNS-7530 optical/laser trackball sensor

compatible: "adns,adns7530"

include: spi-device.yaml

properties:
  pow-gpios:
    type: phandle-array
    required: false
    description: Power enable GPIO pin (Active LOW)

  irq-gpios:
    type: phandle-array
    required: false
    description: Motion interrupt GPIO pin

  cpi:
    type: int
    default: 800
    description: Sensor resolution in counts per inch

  evt-type:
    type: int
    default: 2 # INPUT_EV_REL
    description: Input event type to generate

  x-input-code:
    type: int
    default: 0 # INPUT_REL_X
    description: Input event code for X movement

  y-input-code:
    type: int
    default: 1 # INPUT_REL_Y
    description: Input event code for Y movement

  invert-x:
    type: boolean
    description: Invert X axis motion

  invert-y:
    type: boolean
    description: Invert Y axis motion

  swap-xy:
    type: boolean
    description: Swap X and Y axes
```

## dts/bindings/sensor/bto,paw3204.yaml
```yaml
description: Bit Trade One ADTB7M PAW3204 Optical Trackball Sensor

compatible: "bto,paw3204"

properties:
  sclk-gpios:
    type: phandle-array
    required: true
    description: Clock GPIO pin

  data-gpios:
    type: phandle-array
    required: true
    description: Bi-directional SDIO data GPIO pin

  cs-gpios:
    type: phandle-array
    required: false
    description: Chip select GPIO pin

  pow-gpios:
    type: phandle-array
    required: false
    description: Power enable GPIO pin
```
